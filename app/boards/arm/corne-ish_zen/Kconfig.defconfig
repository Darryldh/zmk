## app/boards/arm/corne-ish_zen/Kconfig.defconfig
```kconfig
# Copyright (c) 2020 Darryl deHaan
# SPDX-License-Identifier: MIT

if BOARD_CORNEISH_ZEN_LEFT

	config ZMK_KEYBOARD_NAME
	default "Corne-ish Zen"

endif # BOARD_CORNEISH_ZEN_LEFT

if BOARD_CORNEISH_ZEN_RIGHT

	config ZMK_KEYBOARD_NAME
	default "Corne-ish Zen (right)"

endif # BOARD_CORNEISH_ZEN_RIGHT


if BOARD_CORNEISH_ZEN_LEFT || BOARD_CORNEISH_ZEN_RIGHT

config BOARD
	default "corne-ish_zen"

config ZMK_SPLIT
	default y

config I2C
	bool
	default y

menuconfig SENSOR
    bool "Sensor Drivers"

config MAX17055
    bool "MAX17055 Fuel Gauge"
    depends on I2C && SENSOR

#config SPI
#    bool
#    default y

config BT_CTLR
	default BT

config ZMK_BLE
	default y

config ZMK_USB
	default y

#Config ZMK_BATTERY_VOLTAGE_DIVIDER 
#	default n

if USB

config USB_NRFX
	default y

config USB_DEVICE_STACK
	default y

endif # USB

if ZMK_DISPLAY

config SPI
	default y

config IL0323
	default y

endif # ZMK_DISPLAY

if LVGL

config LVGL_HOR_RES_MAX
	default 80

config LVGL_VER_RES_MAX
	default 128

config LVGL_VDB_SIZE
	default 100

config LVGL_DPI
	default 145

config LVGL_BITS_PER_PIXEL
	default 1

choice LVGL_COLOR_DEPTH
	default LVGL_COLOR_DEPTH_1
endchoice

endif # LVGL

endif # BOARD_CORNEISH_ZEN_LEFT || BOARD_CORNEISH_ZEN_RIGHT
```

## app/boards/arm/corne-ish_zen/corne-ish_zen_left_defconfig
```kconfig
# SPDX-License-Identifier: MIT

CONFIG_SOC_SERIES_NRF52X=y
CONFIG_SOC_NRF52840_QIAA=y
CONFIG_BOARD_CORNEISH_ZEN_LEFT=y
CONFIG_ZMK_SPLIT=y
CONFIG_ZMK_SPLIT_BLE_ROLE_CENTRAL=y
CONFIG_ZMK_SLEEP=y
CONFIG_ZMK_DISPLAY=y
CONFIG_SSD1306=n

# set tx pwr to +8 dbi
CONFIG_BT_CTLR_TX_PWR_PLUS_8=y

# Enable MPU
CONFIG_ARM_MPU=y

# enable GPIO
CONFIG_GPIO=y

# Enable I2C
CONFIG_I2C=y
CONFIG_I2C_NRFX=y
CONFIG_I2C_0=y

# Enable SPI
CONFIG_SPI=y
CONFIG_SPI_2=y
CONFIG_SPI_NRFX=y

# Enable writing to flash
CONFIG_USE_DT_CODE_PARTITION=y
CONFIG_MPU_ALLOW_FLASH_WRITE=y
CONFIG_NVS=y
CONFIG_SETTINGS_NVS=y
CONFIG_FLASH=y
CONFIG_FLASH_PAGE_LAYOUT=y
CONFIG_FLASH_MAP=y

# Enable external crystal
CONFIG_CLOCK_CONTROL_NRF_K32SRC_XTAL=y
CONFIG_CLOCK_CONTROL_NRF_K32SRC_30PPM=y

# Enable MAX 17055 Fuel Gauge
CONFIG_SENSOR=y
CONFIG_MAX17055=y

CONFIG_IL0323=y
CONFIG_LVGL_HOR_RES_MAX=80
CONFIG_LVGL_VER_RES_MAX=128
CONFIG_LVGL_BITS_PER_PIXEL=1
CONFIG_LVGL_COLOR_DEPTH_1=y
CONFIG_LVGL_DPI=145
CONFIG_LVGL_VDB_SIZE=32
CONFIG_LVGL_USE_THEME_MONO=y
```
